## meta/conf/machine/sm2s-rzv2l.conf
```bitbake
#@TYPE: Machine
#@NAME: smarc-rzv2l machine
#@DESCRIPTION: RZ/G2L SMARC platform

MACHINEOVERRIDES =. "smarc-rzv2l:"

SOC_FAMILY = "r9a07g054l"
require ../../meta-renesas.git/conf/machine/include/rzv2l-common.inc
require ../../meta-renesas.git/conf/machine/include/cip-core.inc

DEFAULTTUNE ?= "cortexa55"

TUNE_CONF ?= "../../meta-renesas.git/conf/machine/include/tune-cortexa55.inc"
require ${TUNE_CONF}

PREFERRED_PROVIDER_virtual/kernel = "linux-renesas"
UBOOT_CONFIG ??= "smarc-rzv2l"
UBOOT_CONFIG[smarc-rzv2l] = "smarc-rzv2l_defconfig"

# flash writer
EXTRA_IMAGEDEPENDS += " flash-writer"

# Supported devicetree
KERNEL_DEVICETREE = " \
	renesas/r9a07g054l2-smarc.dtb \
"

ROOTFS_POSTPROCESS_COMMAND_remove += " remove_boot; "
```
